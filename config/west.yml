## config/west.yml
```yaml
manifest:
  defaults:
    revision: v0.3
  remotes:
    - name: zmkfirmware
      url-base: https://github.com/zmkfirmware
    - name: englmaxi
      url-base: https://github.com/englmaxi
    - name: te9no
      url-base: https://github.com/te9no
    - name: badjeff
      url-base: https://github.com/badjeff
    - name: zettaface
      url-base: https://github.com/zettaface
    - name: sekigon-gonnoc
      url-base: https://github.com/sekigon-gonnoc
    - name: efogdev
      url-base: https://github.com/efogdev
    - name: cormoran
      url-base: https://github.com/cormoran
    # Additional modules containing boards/shields/custom code can be listed here as well
    # See https://docs.zephyrproject.org/3.2.0/develop/west/manifest.html#projects
  projects:
    - name: zmk
      remote: cormoran
      revision: v0.3-branch+dya
      import: app/west.yml
    - name: zmk-module-ble-management
      remote: cormoran
      revision: main
    - name: zmk-module-battery-history
      remote: cormoran
      revision: main
    - name: zmk-module-settings-rpc
      remote: cormoran
      revision: main
    - name: zmk-module-runtime-input-processor
      remote: cormoran
      revision: main
    - name: zmk-dongle-display
      remote: te9no
      revision: main
    - name: zmk-pmw3610-driver
      remote: efogdev
      revision: main
    - name: zmk-input-processor-keybind
      remote: zettaface
      revision: main
    - name: zmk-feature-non-lipo-battery-management
      remote: sekigon-gonnoc
      revision: main
  self:
    path: config
```
